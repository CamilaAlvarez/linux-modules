/dts-v1/;
/plugin/;
/ {
    compatible = "brcm,bcm2835", "brcm,bcm2836", "brcm,bcm2708", "brcm,bcm2709", "brcm,bcm2711";
    @fragment0 {
        target-path = "/";
        __overlay__ {
            dht11_module_device {
                compatible = "calvarez,dht11";
                temperature-gpio = <&gpio 17 0>; //GPIO_ACTIVE_HIGH is 0
            };
        };
    };
};