/dts-v1/;
/plugin/;
/ {
    compatible = "brcm,bcm2835", "brcm,bcm2836", "brcm,bcm2708", "brcm,bcm2709", "brcm,bcm2711";
    fragment@0 {
        target = <&i2c1>;
        __overlay__ {
            #address-cells = <1>;
            #size-cells = <0>;
            mq135: mq135@48 {
                compatible = "calvarez,mq135";
                reg = <0x48>; # board already has a pull-down resistor that controls ADDR to GND 
                status = "okay";
            };
        };
    };
};